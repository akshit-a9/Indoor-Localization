// WayPoint Collect: records ESP32 WiFi scans at the spots the phone already
// recorded, so the two can be compared (and the phone data reused).
//
// The ESP32 makes its own WiFi network. A phone joins it and opens the page,
// picks a spot, confirms it is standing there, and presses Start. The ESP32
// then scans for 90 s while the person turns 45 degrees right every 11 s,
// and saves the scans to its flash. The OLED and RGB LED repeat the
// instructions in case the phone screen goes off.
//
//   recorder.*   countdown, scanning, turn timing
//   storage.*    takes on flash, CSV export, copy to Serial for a laptop
//   web.*        the phone page and its API (page itself in web_page.h)
//   display.*    OLED screens
//   leds.*       phone LED + RGB status LED
//   locations.h, floor_maps.h   generated by ../make_assets.py from 02_Data
//   config.h     pins, WiFi name, timings

#include <WiFi.h>

#include "config.h"
#include "display.h"
#include "leds.h"
#include "locations.h"
#include "recorder.h"
#include "storage.h"
#include "web.h"

static const uint32_t UI_REFRESH_MS = 200;

// Shows the recorder state on the OLED and LEDs.
static void updateUi() {
  const RecorderInfo &rec = recorderInfo();
  const char *label = rec.location >= 0 ? LOCATIONS[rec.location].label : "";
  int secondsLeft = (rec.msLeft + 999) / 1000;
  phoneLedSet(WiFi.softAPgetStationNum() > 0);

  switch (rec.state) {
    case REC_COUNTDOWN:
      statusLedSet(STATUS_COUNTDOWN);
      displayCountdown(label, secondsLeft);
      break;
    case REC_RECORDING: {
      bool turnNow = rec.turnedAt && millis() - rec.turnedAt < TURN_CUE_MS;
      bool blinkOn = (millis() / 250) % 2;
      statusLedSet(turnNow ? (blinkOn ? STATUS_TURN : STATUS_OFF) : STATUS_RECORDING);
      displayRecording(label, secondsLeft, rec.heading, rec.scans, turnNow);
      break;
    }
    case REC_DONE:
      statusLedSet(STATUS_READY);
      displayMessage("Saved!", String(label) + " (" + rec.scans + " scans). Pick the next spot on the phone.");
      break;
    case REC_ERROR:
      statusLedSet(STATUS_ERROR);
      displayMessage("Error", rec.error);
      break;
    default: {
      int done = 0;
      for (int i = 0; i < LOCATION_COUNT; ++i) done += storageTakeCount(i) > 0;
      statusLedSet(STATUS_READY);
      displayReady(done, LOCATION_COUNT);
      break;
    }
  }
}

void setup() {
  Serial.begin(SERIAL_BAUD);
  Serial.println("\nWayPoint Collect starting");

  ledsInit();
  displayInit();
  displayMessage("WayPoint Collect", "Starting...");

  if (!storageInit()) {
    statusLedSet(STATUS_ERROR);
    displayMessage("Error", "Flash storage failed. Check the partition scheme.");
    Serial.println("LittleFS mount failed");
    while (true) delay(1000);
  }
  Serial.printf("Flash: %u of %u KB used\n", storageUsedBytes() / 1024, storageTotalBytes() / 1024);

  // AP for the phone + station interface for scanning
  WiFi.mode(WIFI_AP_STA);
  WiFi.softAP(AP_SSID, AP_PASSWORD, AP_CHANNEL);
  Serial.printf("WiFi %s up, page at http://%s/\n", AP_SSID, WiFi.softAPIP().toString().c_str());

  webInit();
}

void loop() {
  webLoop();
  recorderLoop();

  static uint32_t lastUi = 0;
  if (millis() - lastUi >= UI_REFRESH_MS) {
    lastUi = millis();
    updateUi();
  }
}
